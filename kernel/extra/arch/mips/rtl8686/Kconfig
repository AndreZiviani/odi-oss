## kernel/extra/drivers/net/ethernet/odi/Kconfig
```kconfig
# SPDX-License-Identifier: GPL-2.0
menu "odi-oss drivers"
	depends on MACH_RTL8686

config ODI_NIC
	bool "CPU-port NIC (RTL9602C)"
	help
	  The Ethernet NIC of the CPU port of the switch (odi_nic.c): eth0
	  and its VLAN subinterfaces, and the RX hooks and raw TX the OMCI
	  transport uses.

config ODI_SWITCH
	bool "Switch core, GPON MAC and OMCI transport (RTL9602C)"
	depends on ODI_NIC
	select FW_LOADER
	select CRC32
	help
	  Everything between the NIC and the fibre: the switch-core register
	  and table layer, the OMCI driver commands and their netlink
	  transport (/proc/odi_omci), the GPON MAC with its activation state
	  machine and PLOAM and the switch interrupt, /proc/odi_init with
	  the SDK-init verbs, the board-init replay and /dev/odi_sw. The
	  register replay tables are firmware files under /lib/firmware/odi/
	  (hence FW_LOADER, and CRC32 to check each file).

config ODI_WDT
	bool "Watchdog kicker and userland deadline (RTL9602C)"
	help
	  Kicks the hardware watchdog from a kthread and resets the board
	  120 s into a boot that userland has not confirmed
	  (/proc/odi_wdt/userland_ok); reboot resets through the
	  watchdog at once (odi_wdt.c).

config ODI_RAMLOG
	bool "DRAM console that survives a watchdog reset"
	help
	  Mirrors the console into two fixed DRAM pages that a watchdog
	  reset keeps, and shows the previous boot's pages as
	  /proc/odi_ramlog_prev (odi_ramlog.c).

endmenu
```
